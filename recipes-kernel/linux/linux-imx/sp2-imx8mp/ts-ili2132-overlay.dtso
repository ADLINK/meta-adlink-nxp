// SPDX-License-Identifier: (GPL-2.0+ OR MIT)
/*
 * Copyright 2024 ADLINK Technology Corp.
 *
 * Author: Po Cheng <po.cheng@adlinktech.com>
 */

/dts-v1/;
/plugin/;

/ {
	fragment@0 {
		target = <&i2c2>;
		__overlay__ {
			/* TS: ILI2132 */
			ts: ilitek_2132@41 {
				compatible = "ilitek,ili2132";
				reg = <0x41>;
				/* MX8MP_IOMUXC_SAI1_TXD6__GPIO4_IO18 */
				interrupt-parent = <&gpio4>;
				interrupts = <18 0x01>; /* IRQ_TYPE_EDGE_FALLING (0x01) */
				/* ilitek,reset-gpio = <&gpio6 8 0x0>; */
				status = "okay";
			};
		};
	};
};

