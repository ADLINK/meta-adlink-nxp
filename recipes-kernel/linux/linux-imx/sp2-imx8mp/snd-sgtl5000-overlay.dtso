// SPDX-License-Identifier: (GPL-2.0+ OR MIT)
/*
 * Copyright 2023 ADLINK Technology Corp.
 *
 * Author: Po Cheng <po.cheng@adlinktech.com>
 */

/dts-v1/;
/plugin/;

/ {
	fragment@0 {
		target-path = "/";
		__overlay__ {
			sound {
				status = "okay";
			};
		};
	};

	fragment@1 {
		target = <&sgtl5000>;
		__overlay__ {
			status = "okay";
		};
	};
};
