// SPDX-License-Identifier: (GPL-2.0+ OR MIT)
/*
 * Copyright 2023 ADLINK Technology Corp.
 *
 * Author: Po Cheng <po.cheng@adlinktech.com>
 */

/dts-v1/;
/plugin/;

/ {
	fragment@0 {
		target-path = "/";
		__overlay__ {
			reserved-memory {
				linux,cma {
					/* 40000000 = 1073741824 (1GiB) */
					/* 20000000 =  536870912 (500MiB) */
					size = <0 0x3c000000>; /* 1GiB - 50331648 (50MiB) = 950 MiB */
				};
			};
		};
	};
};

