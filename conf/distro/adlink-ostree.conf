## conf/machine/lec-imx95.conf
```bitbake
#machine configuration file for LEC-IMX95

MACHINEOVERRIDES =. "mx95:"

KBUILD_DEFCONFIG:lec-imx95 = "lec-imx95_defconfig"

require conf/machine/include/imx95-evk.inc


# kernel
IMX_KERNEL_CONFIG_AARCH64:lec-imx95 = "lec-imx95_defconfig"

# The device tree name is implicit for LPDDR4, so can't use MACHINE here
KERNEL_DEVICETREE_BASENAME = "lec-imx95"
KERNEL_DEVICETREE = " \
        adlink/${KERNEL_DEVICETREE_BASENAME}.dtb \
	adlink/${KERNEL_DEVICETREE_BASENAME}-cameras-lvds.dtb \
	adlink/${KERNEL_DEVICETREE_BASENAME}-lt9611.dtb \
	adlink/${KERNEL_DEVICETREE_BASENAME}-lt96114k.dtb \
	adlink/${KERNEL_DEVICETREE_BASENAME}-g080uan02.dtb \
	adlink/${KERNEL_DEVICETREE_BASENAME}-g156hat02.6.dtb \		
	adlink/${KERNEL_DEVICETREE_BASENAME}-ov5640.dtb \
	adlink/${KERNEL_DEVICETREE_BASENAME}-ov13855.dtb \		
	adlink/${KERNEL_DEVICETREE_BASENAME}-lt9611-pcie8997.dtb \
	adlink/${KERNEL_DEVICETREE_BASENAME}-ov13855-lvds.dtb \
	adlink/${KERNEL_DEVICETREE_BASENAME}-lt9611-noconsole.dtb \
	adlink/${KERNEL_DEVICETREE_BASENAME}-lt9611-uart2.dtb \
        adlink/${KERNEL_DEVICETREE_BASENAME}-lt9611-spi7.dtb \
	${@bb.utils.contains('NEUTRON_SUPPORT', '1', 'adlink/${KERNEL_DEVICETREE_BASENAME}-neutron.dtb', '', d)} \
"
# over device tree overlay
EXTRA_OEMAKE:append:pn-linux-imx = " DTC_FLAGS='-@ -H epapr'"

# kernel patches
EXTRA_KERNEL_PATCHES = " \
        file://lec-imx95/lec-imx95_defconfig \
        file://lec-imx95/0002-LEC-IMX95-Add-ADL1000-driver.patch \
        file://lec-imx95/0003-LEC-IMX95-Add-ADLINK-LT9611-driver.patch \
        file://lec-imx95/0004-LEC-IMX95-G156HAT026-and-audio-codec-support.patch \
"
EXTRA_KERNEL_DTS = " \
        file://lec-imx95/${KERNEL_DEVICETREE_BASENAME}.dts  \
        file://lec-imx95/${KERNEL_DEVICETREE_BASENAME}-cameras-lvds.dts \
	file://lec-imx95/${KERNEL_DEVICETREE_BASENAME}-lt9611.dts \
	file://lec-imx95/${KERNEL_DEVICETREE_BASENAME}-lt96114k.dts \
	file://lec-imx95/${KERNEL_DEVICETREE_BASENAME}-g080uan02.dts \ 
	file://lec-imx95/${KERNEL_DEVICETREE_BASENAME}-g156hat02.6.dts \  	
	file://lec-imx95/${KERNEL_DEVICETREE_BASENAME}-ov5640.dts \ 
	file://lec-imx95/${KERNEL_DEVICETREE_BASENAME}-ov13855.dts \  
	file://lec-imx95/${KERNEL_DEVICETREE_BASENAME}-lt9611-pcie8997.dts \
	file://lec-imx95/${KERNEL_DEVICETREE_BASENAME}-ov13855-lvds.dts \
	file://lec-imx95/${KERNEL_DEVICETREE_BASENAME}-lt9611-noconsole.dts \
	file://lec-imx95/${KERNEL_DEVICETREE_BASENAME}-lt9611-uart2.dts \
	file://lec-imx95/${KERNEL_DEVICETREE_BASENAME}-uart2.dts \
        file://lec-imx95/${KERNEL_DEVICETREE_BASENAME}-lt9611-spi7.dts \
        ${@bb.utils.contains('NEUTRON_SUPPORT', '1', 'file://lec-imx95/${KERNEL_DEVICETREE_BASENAME}-neutron.dts', '', d)} \
"
EXTRA_SRC_DTS = " \
        file://lec-imx95/imx95.dtsi \
        file://lec-imx95/imx95-pinfunc.h \
        file://lec-imx95/imx95-clock.h \
        file://lec-imx95/imx95-power.h \
        file://lec-imx95/lt9611-basic.dtsi \
        file://lec-imx95/lt96114k-basic.dtsi \
        file://lec-imx95/ov5640-basic.dtsi \
	file://lec-imx95/ov13855-basic.dtsi \
	file://lec-imx95/g156hat02.6-basic.dtsi \
	file://lec-imx95/g080uan02-basic.dtsi \
"

KERNEL_SRC_PATCHES[lec-imx95] = " \
        ${EXTRA_KERNEL_PATCHES} \
        ${EXTRA_KERNEL_DTS} \
        ${EXTRA_SRC_DTS} \
"

#u-boot
UBOOT_CONFIG_BASENAME = "lec-imx95"

UBOOT_DTB_NAME = "lec-imx95.dtb"
UBOOT_CONFIG = "sd"
UBOOT_CONFIG[sd] = "${UBOOT_CONFIG_BASENAME}_defconfig,sdcard"

EXTRA_UBOOT_PATCHES = " \
  file://lec-imx95/lec-imx95_defconfig \
  file://lec-imx95/0001-Added-NXP-common-files.patch \
  file://lec-imx95/0002-Added-support-for-lec-imx95-platform.patch \
"
EXTRA_UBOOT_DTS = " \
  file://lec-imx95/lec-imx95.dts \
  file://lec-imx95/lec-imx95-u-boot.dtsi \
"
UBOOT_SRC_PATCHES[lec-imx95] = " \
        ${EXTRA_UBOOT_PATCHES} \
        ${EXTRA_UBOOT_DTS} \
"

EXTRA_IMXBOOT_PATCHES = "file://lec-imx95/0001-LEC-IMX95-Add-timing-data-configurations.patch"
IMXBOOT_TARGETS_BASENAME = "flash"
OEI_BOARD  = "mx95lp5"
DDR_TYPE   = "lpddr5"
DDR_FIRMWARE_NAME = " \
    lpddr5_dmem_v202409.bin \
    lpddr5_dmem_qb_v202409.bin \
    lpddr5_imem_v202409.bin \
    lpddr5_imem_qb_v202409.bin \
"

OEI_CONFIGS = "ddr tcm dat"

OEI_DDR_CONFIG     = "MIMX95_LPDDR5_EVK_19X19_6400MTS_FW2024.09_timing"
OEI_DDR_CONFIG_ECC = "MIMX95_LPDDR5_EVK_19X19_6400MTS_FW2024.09_ECC_enabled_timing"

M4_DEFAULT_IMAGE_MX95 = "${@bb.utils.contains('SYSTEM_MANAGER_CONFIG', 'mx95netc', 'imx95-19x19-evk_m7_TCM_netc_share.bin', \
                                                                                   'imx95-19x19-evk_m7_TCM_power_mode_switch.bin', d)}"


SYSTEM_MANAGER_CONFIG = "mx95lec"
IMAGE_FSTYPES:append = " wic wic.md5sum"

IMAGE_BOOT_FILES:append = " \
    mcore-demos/imx95-19x19-evk_m7_TCM_flexcan_linux.bin \
    mcore-demos/imx95-19x19-evk_m7_TCM_hello_world.bin \
    mcore-demos/imx95-19x19-evk_m7_TCM_netc_share.bin \
    mcore-demos/imx95-19x19-evk_m7_TCM_power_mode_switch.bin \
    mcore-demos/imx95-19x19-evk_m7_TCM_rpmsg_lite_pingpong_rtos_linux_remote.bin \
    mcore-demos/imx95-19x19-evk_m7_TCM_rpmsg_lite_str_echo_rtos.bin \
    mcore-demos/imx95-19x19-evk_m7_TCM_sai_low_power_audio.bin \
    ${@bb.utils.contains('COMBINED_FEATURES', 'xen', 'xen', '', d)} \
"

#installation dependencies
MACHINE_EXTRA_RDEPENDS += " \
    firmware-nxp-wifi \
    tpm2-tss \
    libtss2-tcti-device \
    tpm2-tools \
"
```

## conf/machine/osm-imx93.conf
```bitbake
#@TYPE: Machine
#@NAME: ADLINK OSM-IMX93 with LPDDR4X
#@SOC: i.MX93
#@DESCRIPTION: Machine configuration for NXP i.MX 93 11x11 EVK with LPDDR4X
#@MAINTAINER: Jun Zhu <junzhu@nxp.com>

MACHINEOVERRIDES =. "mx93:"

require conf/machine/include/imx93-evk.inc

IMX_KERNEL_CONFIG_AARCH64:osm-imx93 = "osm-imx93_defconfig"
KBUILD_DEFCONFIG:osm-imx93 = "osm-imx93_defconfig"

KERNEL_DEVICETREE_BASENAME = "osm-imx93"

KERNEL_DEVICETREE = " \
    adlink/${KERNEL_DEVICETREE_BASENAME}.dtb \
"
EXTRA_KERNEL_PATCHES =   " \
             file://osm-imx93/0001-Added-DP83867-PHY-LED-support.patch.patch \
             file://osm-imx93/0002-Added-TLV320AIC3X-codec-support.patch \
             file://osm-imx93/osm-imx93_defconfig \
             "

EXTRA_KERNEL_DTS = "\
             file://osm-imx93/osm-imx93.dts \
             file://osm-imx93/osm-imx93-lvds-panel.dts \
"
KERNEL_SRC_PATCHES[osm-imx93] = " \
	${EXTRA_KERNEL_PATCHES} \
	${EXTRA_KERNEL_DTS} \
"

# u-boot
UBOOT_CONFIG_BASENAME = "imx93_osm"
UBOOT_CONFIG[fspi] = "${UBOOT_CONFIG_BASENAME}_defconfig"
UBOOT_DTB_NAME = "osm-imx93.dtb"

EXTRA_UBOOT_PATCHES = " \
  file://osm-imx93/imx93_osm_defconfig \
  file://osm-imx93/0001-Added-Adlink-osm-imx93-Board-support.patch \
"
EXTRA_UBOOT_DTS = " \
  file://osm-imx93/osm-imx93.dts  \
  file://osm-imx93/osm-imx93-u-boot.dtsi  \
"

UBOOT_SRC_PATCHES[osm-imx93] = " \
	${EXTRA_UBOOT_PATCHES} \
	${EXTRA_UBOOT_DTS} \
"
# Overrides for imx93-11x11-lpddr4x-evk.conf
MACHINE_FEATURES:append:osm-imx93 = " dpdk nxpiw612-sdio"
MACHINE_FIRMWARE:append:osm-imx93 = " ethos-u-firmware"

WIC_PARTITION_TABLE_TYPE = "msdos"
IMAGE_FSTYPES:append = " wic wic.md5sum"

WIC_FSTAB_BLKDEV = "mmcblk1"

DDR_FIRMWARE_NAME = " \
    lpddr4_dmem_1d_v202201.bin \
    lpddr4_dmem_2d_v202201.bin \
    lpddr4_imem_1d_v202201.bin \
    lpddr4_imem_2d_v202201.bin \
"

WKS_FILE_DEPENDS:append:imx-nxp-bsp = " imx-m33-demos"
IMAGE_BOOT_FILES:append:imx-nxp-bsp = " \
    mcore-demos/imx93-11x11-evk_m33_TCM_power_mode_switch.bin \
    mcore-demos/imx93-11x11-evk_m33_TCM_rpmsg_lite_pingpong_rtos_linux_remote.bin \
    mcore-demos/imx93-11x11-evk_m33_TCM_rpmsg_lite_str_echo_rtos.bin \
    mcore-demos/imx93-11x11-evk_m33_TCM_sai_low_power_audio.bin \
"
```

## conf/machine/osm-imx95.conf
```bitbake
#machine configuration file for OSM-IMX8MP

MACHINEOVERRIDES =. "mx95:"

require conf/machine/include/imx95-evk.inc

# kernel
IMX_KERNEL_CONFIG_AARCH64:osm-imx95 = "osm-imx95_defconfig"

# The device tree name is implicit for LPDDR4, so can't use MACHINE here
KERNEL_DEVICETREE_BASENAME = "osm-imx95"
KERNEL_DEVICETREE = " \
		adlink/${KERNEL_DEVICETREE_BASENAME}.dtb \
		adlink/${KERNEL_DEVICETREE_BASENAME}-1588.dtb \ 
		adlink/${KERNEL_DEVICETREE_BASENAME}-1588-exclk.dtb \ 
		adlink/${KERNEL_DEVICETREE_BASENAME}-1588-exclk-0.dtb \ 
		adlink/${KERNEL_DEVICETREE_BASENAME}-1588-exclk-2.dtb  \
		adlink/${KERNEL_DEVICETREE_BASENAME}-1588-gpio.dtb \
		adlink/${KERNEL_DEVICETREE_BASENAME}-eb4.dtb \
		adlink/${KERNEL_DEVICETREE_BASENAME}-eb4-tpmch1.dtb \ 
		adlink/adlink-eb4-lt9611-lvds.dtb \ 
		adlink/adlink-eb4-lt9611.dtb \
		adlink/adlink-eb4-dsi.dtb \
"

# over device tree overlay
EXTRA_OEMAKE:append:pn-linux-imx = " DTC_FLAGS='-@ -H epapr'"

# kernel patches
EXTRA_KERNEL_PATCHES = " \
file://osm-imx95/osm-imx95_defconfig \
file://osm-imx95/0001-Added-Adlink-ADL1001-device-driver.patch \
file://osm-imx95/0002-Enable-mclk-from-device-tree.patch \
file://osm-imx95/0003-Added-lt9611-driver.patch \
file://osm-imx95/0004-Added-timings-parameters-for-g156hat026-panel.patch \
file://osm-imx95/0005-UART-Port-macro.patch \
file://osm-imx95/0006-Added-support-for-rtc-rx8130.patch \
file://osm-imx95/0007-Set-shutdown-for-scmi.patch \
file://osm-imx95/0008-Poweroff-handler-for-bbm.patch \
file://osm-imx95/0009-Add-clock-mode-rates.patch \
file://osm-imx95/0010-DMA-for-message-buffer-support.patch \
file://osm-imx95/0011-OV13855-kconfig-support.patch \
file://osm-imx95/0012-OV13855-makefile-support.patch \
file://osm-imx95/0013-OV13855-driver-file-support.patch \
file://osm-imx95/0014-Update-power-managerment-suspend-and-resume-function.patch \
file://osm-imx95/0015-Remove-IO-pci-virtulization.patch \
file://osm-imx95/0016-Add-LED-configuration.patch \
file://osm-imx95/0017-Update-MAC-list.patch \
file://osm-imx95/0018-Timer-Event-support.patch \
file://osm-imx95/0019-SCMI-shutdown-update.patch \
"

	
	
EXTRA_KERNEL_DTS = " \
		file://osm-imx95/${KERNEL_DEVICETREE_BASENAME}.dts \
		file://osm-imx95/${KERNEL_DEVICETREE_BASENAME}-1588.dts \ 
		file://osm-imx95/${KERNEL_DEVICETREE_BASENAME}-1588-exclk.dts \ 
		file://osm-imx95/${KERNEL_DEVICETREE_BASENAME}-1588-exclk-0.dts \ 
		file://osm-imx95/${KERNEL_DEVICETREE_BASENAME}-1588-exclk-2.dts  \
		file://osm-imx95/${KERNEL_DEVICETREE_BASENAME}-1588-gpio.dts \
		file://osm-imx95/${KERNEL_DEVICETREE_BASENAME}-eb4.dts \
		file://osm-imx95/${KERNEL_DEVICETREE_BASENAME}-eb4-tpmch1.dts \ 
		file://osm-imx95/adlink-eb4-lt9611-lvds.dts \ 
		file://osm-imx95/adlink-eb4-lt9611.dts \
		file://osm-imx95/adlink-eb4-dsi.dts \
		file://osm-imx95/lt9611-eb4.dts \
		file://osm-imx95/ov13855-eb4.dts \
		file://osm-imx95/g156hat02.6-eb4.dts \
		file://osm-imx95/g080uan02-eb4.dts \		
"

EXTRA_SRC_DTS = " \
	file://osm-imx95/imx95.dtsi \
	file://osm-imx95/imx95-pinfunc.h \
"	

KERNEL_SRC_PATCHES[osm-imx95] = " \
	${EXTRA_KERNEL_PATCHES} \
	${EXTRA_KERNEL_DTS} \
	${EXTRA_SRC_DTS} \
"
IMAGE_ROOTFS_EXTRA_SPACE:append = "${@bb.utils.contains('NEUTRON_SUPPORT', '1', ' + 10485760', '', d)}"

# u-boot
UBOOT_CONFIG_BASENAME = "osm-imx95"
UBOOT_DTB_NAME = "osm-imx95.dtb"
UBOOT_CONFIG = "sd"
UBOOT_CONFIG[sd] = "${UBOOT_CONFIG_BASENAME}_defconfig,sdcard"


# u-boot patches
EXTRA_UBOOT_PATCHES = " \
  file://osm-imx95/0001-Added-osm-imx95-Board-support.patch \
  file://osm-imx95/osm-imx95_defconfig \
"


EXTRA_UBOOT_DTS = " \
  file://osm-imx95/osm-imx95.dts \
  file://osm-imx95/imx95.dtsi \
  file://osm-imx95/osm-imx95-u-boot.dtsi \
"
UBOOT_SRC_PATCHES[osm-imx95] = " \
	${EXTRA_UBOOT_PATCHES} \
	${EXTRA_UBOOT_DTS} \
"

EXTRA_IMXBOOT_PATCHES = "file://osm-imx95/0001-Added-DDR-config-binary-into-Image.patch"
IMXBOOT_TARGETS_BASENAME = "flash"
OEI_BOARD  = "mx95lp4x-15"
DDR_TYPE   = "lpddr4x"
OEI_CONFIGS = "ddr tcm dat"

DDR_FIRMWARE_NAME = " \
    lpddr4x_dmem_qb_v202409.bin \
    lpddr4x_dmem_v202409.bin \
    lpddr4x_imem_qb_v202409.bin \
    lpddr4x_imem_v202409.bin \
"

#SYSTEM_MANAGER_CONFIG = "mx95lec"
M4_DEFAULT_IMAGE_MX95 = "${@bb.utils.contains('SYSTEM_MANAGER_CONFIG', 'mx95netc', 'imx95-19x19-evk_m7_TCM_netc_share.bin', \
                                                                                   'imx95-19x19-evk_m7_TCM_power_mode_switch.bin', d)}"

IMAGE_BOOT_FILES:append = " \
	mcore-demos/imx95-19x19-evk_m7_TCM_flexcan_linux.bin \
	mcore-demos/imx95-19x19-evk_m7_TCM_low_power_wakeword.bin \
	mcore-demos/imx95-19x19-evk_m7_TCM_netc_share.bin \
	mcore-demos/imx95-19x19-evk_m7_TCM_power_mode_switch.bin \
	mcore-demos/imx95-19x19-evk_m7_TCM_rpmsg_lite_pingpong_rtos_linux_remote.bin \
	mcore-demos/imx95-19x19-evk_m7_TCM_rpmsg_lite_str_echo_rtos.bin \
	mcore-demos/imx95-19x19-evk_m7_TCM_sai_low_power_audio.bin \
    ${@bb.utils.contains('COMBINED_FEATURES', 'xen', 'xen', '', d)} \
"
# wic
IMAGE_FSTYPES:append = " wic wic.md5sum"
```
