## conf/layer.conf
```bitbake
# We have a conf and classes directory, add to BBPATH
BBPATH .= ":${LAYERDIR}"

# We have a packages directory, add to BBFILES
BBFILES += "${LAYERDIR}/recipes-*/*/*.bb \
            ${LAYERDIR}/recipes-*/*/*.bbappend"

BBFILE_PRIORITY_adlink-nxp = "10"

BBFILE_COLLECTIONS += "adlink-nxp"
BBFILE_PATTERN_adlink-nxp := "^${LAYERDIR}"

LAYERSERIES_COMPAT_adlink-nxp = "scarthgap"

BBFILES_DYNAMIC += " \
	lec-imx8mp:${LAYERDIR}/dynamic-layers/recipes-nxp-demo-experience/*/*.bbappend \	
	lec-imx95:${LAYERDIR}/dynamic-layers/recipes-gopoint/*/*.bbappend \	
	osm-imx93:${LAYERDIR}/dynamic-layers/recipes-gopoint/*/*.bbappend \
	imx-machine-learning:${LAYERDIR}/dynamic-layers/meta-imx-ml/*/*/*.bbappend \
	virtualization-layer:${LAYERDIR}/dynamic-layers/meta-virtualization/*/*/*.bb \
	virtualization-layer:${LAYERDIR}/dynamic-layers/meta-virtualization/*/*/*.bbappend \
"
```

## conf/machine/include/lec-imx8mp-r2.inc
```bitbake
EXTRA_KERNEL_PATCHES:append = " \
	file://lec-imx8mp/lec-imx8mp-r2.cfg \
	file://lec-imx8mp/0011-lec-imx8mp-R2-phy-led-and-edid-delay-support.patch \
	file://lec-imx8mp/0012-lec-imx8mp-R2-ov13855-reset-pin-cansleep.patch \
"

KERNEL_DEVICETREE_BASENAME = "lec-imx8mp-r2"

EXTRA_KERNEL_DTS = " \
	file://lec-imx8mp/lec-imx8mp-r2-auoB101UAN01-mipi-panel.dts \
	file://lec-imx8mp/lec-imx8mp-r2-hydis-hv150ux2.dts \
	file://lec-imx8mp/lec-imx8mp-r2.dts \
	file://lec-imx8mp/tlv320aic3x.dtsi \
	file://lec-imx8mp/lec-imx8mp-r2-tlv320aic3x.dts \
	file://lec-imx8mp/lec-imx8mp-r2-tlv320-lvds.dts \
	file://lec-imx8mp/lec-imx8mp-r2-auoG101EAT02p6-lvds-panel.dts \
"
WIFIBT_DTS = "${@bb.utils.contains('DISTRO_FEATURES', 'wifi', 'file://lec-imx8mp/lec-imx8mp-r2-wifi.dts', '', d)}"

EXTRA_UBOOT_PATCHES:append = " file://lec-imx8mp/adlink_lec8mpr2_defconfig"
UBOOT_CONFIG_BASENAME = "adlink_lec8mpr2"
UBOOT_CONFIG[fspi] = "${UBOOT_CONFIG_BASENAME}_defconfig"
```

## conf/machine/include/osm-imx93-512.inc
```bitbake
# ADLINK OSM-IMX93 with 512MB LPDDR4X
# Pulled in by local.conf when UBOOT_EXTRA_CONFIGS contains LPDDR4_512MB

KERNEL_DEVICETREE_BASENAME = "osm-imx93-512"

# kernel
EXTRA_KERNEL_DTS = " \
    file://osm-imx93/osm-imx93-512.dts \
    file://osm-imx93/osm-imx93-512-lvds-panel.dts \
"

# u-boot
UBOOT_DTB_NAME:osm-imx93 = "osm-imx93-512.dtb"


EXTRA_UBOOT_DTS = " \
    file://osm-imx93/osm-imx93-512.dts \
    file://osm-imx93/osm-imx93-u-boot.dtsi \
"
UBOOT_CONFIG_BASENAME = "imx93_osm_512"
EXTRA_UBOOT_PATCHES = " \
    file://0001-Added-Adlink-osm-imx93-Board-support.patch \
    file://0002-osm-imx93-relocate-ethosu-node-name-for-512MB.patch \
    file://0003-osm-imx93-512MB-LPDDR4X-timing.patch \
    file://osm-imx93/imx93_osm_512_defconfig \
"

# no OP-TEE on 512MB
MACHINE_FEATURES:remove = "optee"
```

## conf/machine/lec-imx6.conf
```bitbake
#@TYPE: Machine
#@NAME: NXP i.MX6Solo SABRE Smart Device
#@SOC: i.MX6S
#@DESCRIPTION: Machine configuration for NXP i.MX6Solo SABRE Smart Device
#@MAINTAINER: Otavio Salvador <otavio@ossystems.com.br>

MACHINEOVERRIDES =. "mx6:mx6dl:"

require conf/machine/include/imx6sabresd-common.inc

IMX_KERNEL_CONFIG_ARM:lec-imx6 = "lec_imx6_defconfig"
KBUILD_DEFCONFIG:lec-imx6 = "lec_imx6_defconfig"

KERNEL_DEVICETREE_BASENAME = "lec-imx6s"

KERNEL_DEVICETREE = " \
    adlink/${KERNEL_DEVICETREE_BASENAME}.dtb \
"

EXTRA_KERNEL_PATCHES = " \
               file://lec-imx6/lec_imx6_defconfig \
               file://lec-imx6/0001-Improve-SD-MMC-power-consumption-and-speed.patch \
               file://lec-imx6/0002-net-phy-at803x-support-tx-internal-delay-ps-for-the-.patch \
               file://lec-imx6/0003-Added-tlv320aic3c-codec-support.patch \
               file://lec-imx6/0004-PCI-imx6-power-the-i.MX6Q-PHY-up-again-on-core-reset.patch \
               file://lec-imx6/0005-Adapt-camera-interfaces.patch \
               file://lec-imx6/0006-Fix-suspend-to-RAM-issues.patch \
               file://lec-imx6/0008-optimize-compile-when-6Q-SL-SX-UL-7D-support-is-disa.patch \
               "

EXTRA_KERNEL_DTS = "\
               file://lec-imx6/lec-imx6s.dts \
               file://lec-imx6/lec-imx6.dtsi \
"
KERNEL_SRC_PATCHES[lec-imx6] = " \
        ${EXTRA_KERNEL_PATCHES} \
        ${EXTRA_KERNEL_DTS} \
"
# ==========================================
# U-Boot Configuration for i.MX6 (1GB vs 2GB)
# ==========================================
UBOOT_CONFIG_BASENAME = "adlink_lec_imx6"

# Conditionally select the defconfig based on memory size config
UBOOT_IMX6_DEFCONFIG = "${@bb.utils.contains('UBOOT_EXTRA_CONFIGS', 'LPDDR4_2GB', 'adlink_lec_imx6_s-2_defconfig', 'adlink_lec_imx6_s-1_defconfig', d)}"

# Define UBOOT_CONFIG cleanly using the dynamic variable
UBOOT_CONFIG ??= "sd"
UBOOT_CONFIG[sd] = "${UBOOT_IMX6_DEFCONFIG}"

# Remove UBOOT_MACHINE entirely when using UBOOT_CONFIG
UBOOT_MACHINE = ""

UBOOT_DTB_NAME = "lec-imx6.dtb lec-imx6dl.dtb"

EXTRA_UBOOT_PATCHES = " \
  file://lec-imx6/adlink_lec_imx6_s-1_defconfig \
  file://lec-imx6/adlink_lec_imx6_s-2_defconfig \
  file://lec-imx6/0001-Added-u-boot-board-support.patch \
"

EXTRA_UBOOT_DTS = " \
  file://lec-imx6/lec-imx6dl.dts \
  file://lec-imx6/lec-imx6.dts \
  file://lec-imx6/lec-imx6qdl.dtsi \
  file://lec-imx6/lec-imx6-u-boot.dtsi \
"

UBOOT_SRC_PATCHES[lec-imx6] = " \
    ${EXTRA_UBOOT_PATCHES} \
    ${EXTRA_UBOOT_DTS} \
"

KERNEL_IMAGETYPE = "zImage"

MACHINE_FEATURES:append = " optee"
```

## conf/machine/lec-imx61.conf
```bitbake
#@TYPE: Machine
#@NAME: NXP i.MX6Solo SABRE Smart Device
#@SOC: i.MX6S
#@DESCRIPTION: Machine configuration for NXP i.MX6Solo SABRE Smart Device
#@MAINTAINER: Otavio Salvador <otavio@ossystems.com.br>

MACHINEOVERRIDES =. "mx6:mx6dl:"

require conf/machine/include/imx6sabresd-common.inc

IMX_KERNEL_CONFIG:lec-imx61 = "lec_imx6_defconfig"
KBUILD_DEFCONFIG:lec-imx61 = "lec_imx6_defconfig"

KERNEL_DEVICETREE_BASENAME = "lec-imx6s"

KERNEL_DEVICETREE = " \
    adlink/${KERNEL_DEVICETREE_BASENAME}.dtb \
"

EXTRA_KERNEL_PATCHES =   " \
             file://lec-imx61/lec_imx6_defconfig \
             file://lec-imx61/0002-net-phy-at803x-support-tx-internal-delay-ps-for-the-.patch \
             file://lec-imx61/0004-PCI-imx6-power-the-i.MX6Q-PHY-up-again-on-core-reset.patch \
             "

EXTRA_KERNEL_DTS = "\
             file://lec-imx61/lec-imx6s.dts \
             file://lec-imx61/lec-imx6.dtsi \
"
KERNEL_SRC_PATCHES[lec-imx61] = " \
	${EXTRA_KERNEL_PATCHES} \
	${EXTRA_KERNEL_DTS} \
"

# U-Boot Configuration
UBOOT_CONFIG_BASENAME = "adlink_lec_imx6"

UBOOT_MACHINE = "${UBOOT_CONFIG_BASENAME}_s-1_defconfig"
UBOOT_DTB_NAME = "lec-imx6.dtb lec-imx6dl.dtb"

EXTRA_UBOOT_PATCHES = " \
  file://lec-imx61/adlink_lec_imx6_s-1_defconfig \
  file://lec-imx61/0001-Added-u-boot-board-support.patch \
"
EXTRA_UBOOT_DTS = " \
  file://lec-imx61/lec-imx6dl.dts \
  file://lec-imx61/lec-imx6.dts \
  file://lec-imx61/lec-imx6qdl.dtsi \
  file://lec-imx61/lec-imx6-u-boot.dtsi \
"

UBOOT_SRC_PATCHES[lec-imx61] = " \
        ${EXTRA_UBOOT_PATCHES} \
        ${EXTRA_UBOOT_DTS} \
"

KERNEL_IMAGETYPE = "zImage"

MACHINE_FEATURES:append = " optee"

# ==========================================
# REMOVE OR COMMENT OUT THESE CONFLICTING LINES:
# ==========================================
# UBOOT_CONFIG ??= "${@bb.utils.contains('MACHINE_FEATURES', 'optee', 'sd-optee', 'sd', d)}"
# UBOOT_CONFIG[sd] = "mx6solosabresd_config"
# UBOOT_CONFIG[sd-optee] = "mx6solosabresd_optee_config"
# OPTEE_BIN_EXT = "6solosdb"
```

## conf/machine/lec-imx8mp.conf
```bitbake
#machine configuration file for LEC-IMX8MP

require conf/machine/include/imx8mp-evk.inc

# kernel
IMX_KERNEL_CONFIG_AARCH64:lec-imx8mp = "lec-imx8mp_defconfig"

# The device tree name is implicit for LPDDR4, so can't use MACHINE here
KERNEL_DEVICETREE_BASENAME = "lec-imx8mp"
KERNEL_DEVICETREE = " \
	adlink/${KERNEL_DEVICETREE_BASENAME}-A4-auoB101UAN01-mipi-panel.dtb \
	adlink/${KERNEL_DEVICETREE_BASENAME}-A4-hydis-hv150ux2.dtb \
	adlink/${KERNEL_DEVICETREE_BASENAME}-A4.dtb \
	adlink/${KERNEL_DEVICETREE_BASENAME}-A4-tlv320aic3x.dtb \		
	adlink/${KERNEL_DEVICETREE_BASENAME}-A4-auo-g156han04-0.dtb \
	adlink/${KERNEL_DEVICETREE_BASENAME}-A4-internal_rtc.dtb \	
"
# over device tree overlay
EXTRA_OEMAKE:append:pn-linux-imx = " DTC_FLAGS='-@ -H epapr'"

# kernel patches
EXTRA_KERNEL_PATCHES = " \
	file://lec-imx8mp/lec-imx8mp_defconfig \
	file://lec-imx8mp/0001-Added-LEC-IMX8MP--board-support-based-on-i.MX8MP.patch \
	file://lec-imx8mp/0003-panel-simple-modify-for-auo-10.1-inch-lvds-panel.patch \
	file://lec-imx8mp/0004-lec-imx8mp-tpm-use-default-guard-time-from-dts-to-us.patch \
	file://lec-imx8mp/0005-stmmac-export-symbols-for-modular-build.patch \
	file://lec-imx8mp/0006-Added-Driver-to-get-device-information.patch \
"
EXTRA_KERNEL_PATCHES:append:tinycma = " file://0001-dtb-reduce-cma-size-for-adlink-imx8mp-som.patch"
EXTRA_KERNEL_PATCHES:private = ""
EXTRA_KERNEL_DTS = " \
	file://lec-imx8mp/lec-imx8mp-A4-auoB101UAN01-mipi-panel.dts \
	file://lec-imx8mp/lec-imx8mp-A4-hydis-hv150ux2.dts \
	file://lec-imx8mp/lec-imx8mp-A4.dts \
	file://lec-imx8mp/lec-imx8mp-A4-tlv320aic3x.dts \
	file://lec-imx8mp/lec-imx8mp-A4-auo-g156han04-0.dts \
	file://lec-imx8mp/lec-imx8mp-A4-internal_rtc.dts \
"

#EXTRA_KERNEL_CMA_2G_PATCH = "${@bb.utils.contains('UBOOT_EXTRA_CONFIGS', 'LPDDR4_2GB', 'file://0003-Allocated-CMA-range-based-on-2G-Ram-Size.patch', '', d)}"
#EXTRA_KERNEL_DTS:append = " ${EXTRA_KERNEL_CMA_2G_PATCH}"

KERNEL_SRC_PATCHES[lec-imx8mp] = " \
	${EXTRA_KERNEL_PATCHES} \
	${EXTRA_KERNEL_DTS} \
"

# u-boot
UBOOT_CONFIG_BASENAME = "adlink_lec8mp"
UBOOT_CONFIG[fspi] = "${UBOOT_CONFIG_BASENAME}_defconfig"
UBOOT_DTB_NAME = "lec-imx8mp.dtb"

# u-boot patches
EXTRA_UBOOT_PATCHES = " \
  file://lec-imx8mp/adlink_lec8mp_defconfig \
  file://lec-imx8mp/0001-lec-imx8mp-board-support.patch \
  file://lec-imx8mp/0002-Enable-LS_OE-of-SX1509-Gpio-Expander.patch \
  file://lec-imx8mp/0003-Added-5ms-delay-in-xhci_submit_control_msg-function.patch \
"

EXTRA_UBOOT_DTS = " \
  file://lec-imx8mp/lec-imx8mp.dts \
"
UBOOT_SRC_PATCHES[lec-imx8mp] = " \
	${EXTRA_UBOOT_PATCHES} \
	${EXTRA_UBOOT_DTS} \
"


# Set DDR FIRMWARE
DDR_FIRMWARE_VERSION = "_202006"
DDR_FIRMWARE_NAME = " \
        lpddr4_pmu_train_1d_imem${DDR_FIRMWARE_VERSION}.bin \
        lpddr4_pmu_train_1d_dmem${DDR_FIRMWARE_VERSION}.bin \
        lpddr4_pmu_train_2d_imem${DDR_FIRMWARE_VERSION}.bin \
        lpddr4_pmu_train_2d_dmem${DDR_FIRMWARE_VERSION}.bin \
"

# Set imx-mkimage boot target
IMXBOOT_TARGETS_BASENAME = "flash_evk"

# Set Serial console
SERIAL_CONSOLES = "115200;ttymxc2"

# imx-boot
IMAGE_BOOTLOADER = "imx-boot"
UBOOT_MAKE_TARGET = ""

# imx-atf
ATF_BOOT_UART_BASE = "0x30890000"

# wic
WIC_PARTITION_TABLE_TYPE = "msdos"
WIC_FSTAB_BLKDEV = "mmcblk2"
IMAGE_FSTYPES:append = " wic wic.md5sum"
WKS_FILE_DEPENDS:append = " imx-m7-demos"
IMAGE_BOOT_FILES += "mcore-demos/imx8mp_m7_TCM_hello_world.bin \
                    mcore-demos/imx8mp_m7_TCM_rpmsg_lite_pingpong_rtos_linux_remote.bin \
                    mcore-demos/imx8mp_m7_TCM_rpmsg_lite_str_echo_rtos.bin \
                    mcore-demos/imx8mp_m7_TCM_sai_low_power_audio.bin \
"
```
