## conf/machine/lec-imx6-1.conf
```bitbake
#@TYPE: Machine
#@NAME: ADLINK LEC-iMX6Q/DL 1.0 SMARC modules
#@SOC: i.MX6Q/DL
#@DESCRIPTION: Machine configuration for ADLINK LEC-iMX6Q/DL 1.0 SMARC modules

MACHINEOVERRIDES =. "mx6:mx6q:mx6dl:"

require conf/machine/include/imx6sabresd-common.inc

KERNEL_DEVICETREE = "lec-imx6q.dtb lec-imx6s.dtb"

UBOOT_CONFIG ??= "${@bb.utils.contains('MACHINE_FEATURES', 'optee', 'sd-optee', 'sd', d)}"
UBOOT_CONFIG[sd] = "mx6qsabresd_config,sdcard"
UBOOT_CONFIG[sata] = "mx6qsabresd_sata_config"
UBOOT_CONFIG[mfgtool] = "mx6qsabresd_config"
UBOOT_CONFIG[sd-optee] = "mx6qsabresd_optee_config,sdcard"

KERNEL_IMAGETYPE = "uImage"

SOC_DEFAULT_IMAGE_FSTYPES += "ext4 tar.bz2"
```

## conf/machine/lec-imx6-2.conf
```bitbake
#@TYPE: Machine
#@NAME: ADLINK LEC-iMX6R2-Q/DL/QP SMARC modules
#@SOC: i.MX6R2-Q/DL/QP
#@DESCRIPTION: Machine configuration for ADLINK LEC-iMX6R2-Q/DL/QP SMARC modules

MACHINEOVERRIDES =. "mx6:mx6q:mx6dl:"

require conf/machine/include/imx6sabresd-common.inc

KERNEL_DEVICETREE = "lec-imx6q.dtb lec-imx6s.dtb lec-imx6qp.dtb"

UBOOT_CONFIG ??= "${@bb.utils.contains('MACHINE_FEATURES', 'optee', 'sd-optee', 'sd', d)}"
UBOOT_CONFIG[sd] = "mx6qsabresd_config,sdcard"
UBOOT_CONFIG[sata] = "mx6qsabresd_sata_config"
UBOOT_CONFIG[mfgtool] = "mx6qsabresd_config"
UBOOT_CONFIG[sd-optee] = "mx6qsabresd_optee_config,sdcard"

KERNEL_IMAGETYPE = "uImage"
```

## conf/machine/lec-imx8m.conf
```bitbake
#@TYPE: Machine
#@NAME: ADLink LEC i.MX8M SMARC
#@SOC: i.MX8M
#@DESCRIPTION: Machine configuration for ADLink LEC i.MX8M

MACHINEOVERRIDES =. "mx8:mx8m:mx8mq:"

require conf/machine/include/imx-base.inc
require conf/machine/include/tune-cortexa53.inc

MACHINE_FEATURES += "pci"

MACHINE_SOCARCH_FILTER_append_mx8mq = " virtual/libopenvg virtual/libgles1 virtual/libgles2 virtual/egl virtual/mesa virtual/libgl virtual/libg2d"

KERNEL_DEVICETREE = "adlink/adlink-lec-imx8m.dtb \
		     adlink/adlink-lec-imx8m-dual-display.dtb \
		     adlink/adlink-lec-imx8m-dcss-g133han01.dtb \
		     adlink/adlink-lec-imx8m-lcdif-g104x1l03.dtb \
		     adlink/adlink-lec-imx8m-lcdif-g185xw01.dtb \
		     adlink/adlink-lec-imx8m-lcdif-hv150ux2.dtb \
		     adlink/adlink-lec-imx8m-lcdif-lm215wf3.dtb \
		     adlink/adlink-lec-imx8m-lcdif-n101bge.dtb \
		     adlink/adlink-lec-imx8m-dcss-b101uan01.dtb \
		     adlink/adlink-lec-imx8m-usb-otg-master.dtb \
		     adlink/adlink-lec-imx8m-2gb-ddr3l.dtb \
		     adlink/adlink-lec-imx8m-2gb-ddr3l-dual-display.dtb \
		     adlink/adlink-lec-imx8m-2gb-ddr3l-dcss-g133han01.dtb \
		     adlink/adlink-lec-imx8m-2gb-ddr3l-lcdif-g104x1l03.dtb \
		     adlink/adlink-lec-imx8m-2gb-ddr3l-lcdif-g185xw01.dtb \
		     adlink/adlink-lec-imx8m-2gb-ddr3l-lcdif-hv150ux2.dtb \
		     adlink/adlink-lec-imx8m-2gb-ddr3l-lcdif-lm215wf3.dtb \
		     adlink/adlink-lec-imx8m-2gb-ddr3l-lcdif-n101bge.dtb \
		     adlink/adlink-lec-imx8m-2gb-ddr3l-dcss-b101uan01.dtb \
		     adlink/adlink-lec-imx8m-2gb-ddr3l-usb-otg-master.dtb \
		     adlink/adlink-lec-imx8m-1gb-ddr3l.dtb \
		     adlink/adlink-lec-imx8m-1gb-ddr3l-dual-display.dtb \
		     adlink/adlink-lec-imx8m-1gb-ddr3l-dcss-g133han01.dtb \
		     adlink/adlink-lec-imx8m-1gb-ddr3l-lcdif-g104x1l03.dtb \
		     adlink/adlink-lec-imx8m-1gb-ddr3l-lcdif-g185xw01.dtb \
		     adlink/adlink-lec-imx8m-1gb-ddr3l-lcdif-hv150ux2.dtb \
		     adlink/adlink-lec-imx8m-1gb-ddr3l-lcdif-lm215wf3.dtb \
		     adlink/adlink-lec-imx8m-1gb-ddr3l-lcdif-n101bge.dtb \
		     adlink/adlink-lec-imx8m-1gb-ddr3l-dcss-b101uan01.dtb \
		     adlink/adlink-lec-imx8m-1gb-ddr3l-usb-otg-master.dtb \
		     adlink/adlink-lec-imx8m-2gb-canfd.dtb \
		     adlink/adlink-lec-imx8m-2gb-canfd-40M.dtb \
		     adlink/adlink-lec-imx8m-4gb-canfd.dtb \
		     adlink/adlink-lec-imx8m-4gb-canfd-40M.dtb \
		    "

UBOOT_CONFIG ??= "sd"
UBOOT_CONFIG[sd] = "adlink_lec8m_defconfig,sdcard"
UBOOT_CONFIG[mfgtool] = "adlink_lec8m_defconf"
SPL_BINARY = "spl/u-boot-spl.bin"

# Set DDR FIRMWARE
#DDR_FIRMWARE_NAME = "lpddr4_pmu_train_1d_imem.bin lpddr4_pmu_train_1d_dmem.bin lpddr4_pmu_train_2d_imem.bin lpddr4_pmu_train_2d_dmem.bin"
DDR_FIRMWARE_NAME = "ddr3_imem_1d.bin ddr3_dmem_1d.bin"

# Set u-boot DTB
UBOOT_DTB_NAME = "lec-imx8m.dtb"

# Set imx-mkimage boot target
IMXBOOT_TARGETS = "flash_ddr3l_evk"

PREFERRED_VERSION_u-boot-imx = "2018.03"
PREFERRED_VERSION_imx-boot = "0.2"

# Set Serial console
SERIAL_CONSOLES = "115200;ttymxc0"

IMAGE_BOOTLOADER = "imx-boot"

LOADADDR = ""
UBOOT_SUFFIX = "bin"
UBOOT_MAKE_TARGET = ""
IMX_BOOT_SEEK = "33"

# Add additional firmware
MACHINE_FIRMWARE_append = " linux-firmware-ath10k"

# Use gstreamer 1.14 from meta-freescale
PREFERRED_VERSION_gstreamer1.0 ?= "1.14.imx"
PREFERRED_VERSION_gstreamer1.0-plugins-base ?= "1.14.imx"
PREFERRED_VERSION_gstreamer1.0-plugins-good ?= "1.14.imx"
PREFERRED_VERSION_gstreamer1.0-plugins-bad ?= "1.14.imx"
PREFERRED_VERSION_gstreamer1.0-libav ?= "1.14.0"
```

## conf/machine/lec-imx8mm.conf
```bitbake
#machine configuration file for LEC-IMX8MM

require conf/machine/include/imx8mm-evk.inc

# kernel
IMX_KERNEL_CONFIG_AARCH64:lec-imx8mm = "lec-imx8mm_defconfig"

# The device tree name is implicit for LPDDR4, so can't use MACHINE here
KERNEL_DEVICETREE_BASENAME = "lec-imx8mm"
KERNEL_DEVICETREE = " \
	adlink/${KERNEL_DEVICETREE_BASENAME}-auoB101UAN01-mipi-panel.dtb \
	adlink/${KERNEL_DEVICETREE_BASENAME}-hydis-hv150ux2-lvds-panel.dtb \	
	adlink/${KERNEL_DEVICETREE_BASENAME}-lt9611.dtb \
	adlink/${KERNEL_DEVICETREE_BASENAME}-ov13855.dtb \
	adlink/${KERNEL_DEVICETREE_BASENAME}-imx219.dtb \
	adlink/${KERNEL_DEVICETREE_BASENAME}-ov5647.dtb \
	adlink/${KERNEL_DEVICETREE_BASENAME}.dtb \
"
# unwanted include from imx8mm-evk.inc from meta-freescale
KERNEL_DEVICETREE:remove = " \
	freescale/${KERNEL_DEVICETREE_BASENAME}-pcie-ep.dtb \
	freescale/${KERNEL_DEVICETREE_BASENAME}-rm67191.dtb \
	freescale/${KERNEL_DEVICETREE_BASENAME}-rm67191-cmd-ram.dtb \
	freescale/${KERNEL_DEVICETREE_BASENAME}-rm67199.dtb \
	freescale/${KERNEL_DEVICETREE_BASENAME}-rm67199-cmd-ram.dtb \
"

# for device tree overlay
EXTRA_OEMAKE:append:pn-linux = " DTC_FLAGS='-@ -H epapr'"

# kernel patches
EXTRA_KERNEL_PATCHES = " \
	file://lec-imx8mm/lec-imx8mm_defconfig \
	file://lec-imx8mm/0002-Added-TPM2.0-Support-and-ADLINK-Config-macro.patch \
	file://lec-imx8mm/0003-RealTek-driver-of-Ethernet-PG-tool.patch \
	file://lec-imx8mm/0004-use-buit-in-wifi-bt-firmware-thermal-TJ-point-to-100.patch \
	file://lec-imx8mm/0005-Added-wm8960-Support.patch \
	file://lec-imx8mm/0006-Based-on-CONFIG_IF-update-Ethernet-PHY-register-via.patch \
	file://lec-imx8mm/0007-Added-camera-support-imx219-ov13850-ov13858.patch \
	file://lec-imx8mm/0008-lec-imx8mm-Add-support-for-LT9611-DSI-to-HDMI-Bridge.patch \
	file://lec-imx8mm/0009-Added-support-for-panel-b101uan01.patch \
	file://lec-imx8mm/0010-Added-tlv320aic3x-codec-support.patch \
	file://lec-imx8mm/0011-Added-support-for-CAN-mcp251xfd-Please-refer-to-the-.patch \
"

EXTRA_KERNEL_CAMERA_DTS = " \
	file://lec-imx8mm/lec-imx8mm-imx219.dts \
	file://lec-imx8mm/lec-imx8mm-ov5647.dts \
	file://lec-imx8mm/lec-imx8mm-ov13855.dts \
"
	
EXTRA_KERNEL_DTS = " \
	file://lec-imx8mm/lec-imx8mm-auoB101UAN01-mipi-panel.dts \
	file://lec-imx8mm/lec-imx8mm-hydis-hv150ux2-lvds-panel.dts \
	file://lec-imx8mm/lec-imx8mm-lt9611.dts \
	file://lec-imx8mm/lec-imx8mm.dts \
	${EXTRA_KERNEL_CAMERA_DTS} \
"
KERNEL_SRC_PATCHES[lec-imx8mm] = " \
        ${EXTRA_KERNEL_PATCHES} \
        ${EXTRA_KERNEL_DTS} \
"

# u-boot
UBOOT_CONFIG_BASENAME = "adlink_lec8mm"
UBOOT_CONFIG[fspi] = "adlink_lec8mm_defconfig"
UBOOT_DTB_NAME = "uboot-lec8mm.dtb"

# u-boot patches
EXTRA_UBOOT_PATCHES = " \
	file://lec-imx8mm/adlink_lec8mm_defconfig \
	file://lec-imx8mm/0001-Added-lec-imx8mm-board-support.patch \
	file://lec-imx8mm/0002-Support-lec-imx8mm-u-boot-Kconfig-Makefile-to-build.patch \
	file://lec-imx8mm/0003-Modify-lec-imx8mm-DDR-Initialisation-based-on-GPIO-State.patch \
"
EXTRA_UBOOT_DTS = " \
file://lec-imx8mm/uboot-lec8mm.dts \
"
UBOOT_SRC_PATCHES[lec-imx8mm] = " \
	${EXTRA_UBOOT_PATCHES} \
	${EXTRA_UBOOT_DTS} \
"

# Set DDR FIRMWARE
DDR_FIRMWARE_VERSION = ""
DDR_FIRMWARE_NAME = " \
        lpddr4_pmu_train_1d_imem${DDR_FIRMWARE_VERSION}.bin \
        lpddr4_pmu_train_1d_dmem${DDR_FIRMWARE_VERSION}.bin \
        lpddr4_pmu_train_2d_imem${DDR_FIRMWARE_VERSION}.bin \
        lpddr4_pmu_train_2d_dmem${DDR_FIRMWARE_VERSION}.bin \
"

# Set imx-mkimage boot target
IMXBOOT_TARGETS_BASENAME = "flash_evk"

# Set Serial console
SERIAL_CONSOLES = "115200;ttymxc1"

# imx-boot
IMAGE_BOOTLOADER = "imx-boot"
UBOOT_MAKE_TARGET = ""

ATF_BOOT_UART_BASE  = "0x30890000"

# wic
WIC_PARTITION_TABLE_TYPE = "msdos"
WIC_FSTAB_BLKDEV = "mmcblk2"
IMAGE_FSTYPES:append = " wic wic.md5sum wic.bz2"

# The device tree name is implicit for LPDDR4, so can't use MACHINE here
APPEND += "systemd.unified_cgroup_hierarchy=0"
```

## conf/machine/lec-imx8qm.conf
```bitbake
#@TYPE: Machine
#@NAME: i.MX 8QM B0 MEK
#@DESCRIPTION: i.MX 8QuadMax Multisensory Enablement Kit (MEK) board
#@MAINTAINER: Jun Zhu <junzhu@nxp.com>

MACHINEOVERRIDES =. "mx8:mx8qm:"

require conf/machine/include/imx-base.inc
require conf/machine/include/arm/arch-arm64.inc

MACHINE_FEATURES_append = " optee bcm43455 bcm4356 bcm4359"

# Don't include kernels in standard images
RDEPENDS_${KERNEL_PACKAGE_NAME}-base = ""
RDEPENDS_${KERNEL_PACKAGE_NAME}-image = ""

LOADADDR = ""

# Disable the serial console due to auto-serial-console
SERIAL_CONSOLES = "115200;ttyAMA0"

# we do not want to have getty running on tty1 as we run
# auto-serial-console there
USE_VT = "0"

KERNEL_DEVICETREE = "adlink/adlink-lec-imx8qm-dvi.dtb"
KERNEL_DEVICETREE += "adlink/adlink-lec-imx8qm-hdmi.dtb"
KERNEL_DEVICETREE += "adlink/adlink-lec-imx8qm-ov5640.dtb"
KERNEL_DEVICETREE += "adlink/adlink-lec-imx8qm.dtb"

UBOOT_MAKE_TARGET = \
    "${@bb.utils.contains('COMBINED_FEATURES', 'optee', '', \
                                                        'u-boot.bin', d)}"
SPL_BINARY = \
    "${@bb.utils.contains('COMBINED_FEATURES', 'optee', 'spl/u-boot-spl.bin', \
                                                        '', d)}"
UBOOT_CONFIG ??= "sd"
UBOOT_CONFIG[sd]   = "imx8qm_mek_defconfig,sdcard"
UBOOT_CONFIG[fspi] = "imx8qm_mek_fspi_defconfig"

IMAGE_BOOTLOADER = "imx-boot"
IMX_BOOT_SEEK = "32"

IMAGE_BOOT_FILES += "hdmitxfw.bin hdmirxfw.bin dpfw.bin"

BOARD_TYPE = "mek"

IMXBOOT_TARGETS_SD = \
    "${@bb.utils.contains('COMBINED_FEATURES', 'optee', 'flash_linux_m4 flash_spl', \
                                                        'flash flash_ca72', d)}"
IMXBOOT_TARGETS_FSPI = \
    "${@bb.utils.contains('COMBINED_FEATURES', 'optee', 'flash_spl_flexspi', \
                                                        'flash_flexspi', d)}"
IMXBOOT_TARGETS = \
    "${@bb.utils.contains('UBOOT_CONFIG',         'sd', '${IMXBOOT_TARGETS_SD}', \
                                                        '${IMXBOOT_TARGETS_FSPI}', d)}"
```
