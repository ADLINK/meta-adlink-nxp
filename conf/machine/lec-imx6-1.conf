## conf/machine/sp2-imx8mp.conf
```bitbake
#
# machine configuration file for SP2-IMX8MP
#
require conf/machine/include/imx8mp-evk.inc

#
# kernel
#
DELTA_KERNEL_DEFCONFIG += "adlink-sp2.config kernel-debug.config extra-docker.config"

# The device tree name is implicit for LPDDR4, so can't use MACHINE here
KERNEL_DEVICETREE_BASENAME = "sp2imx8mp"
KERNEL_DEVICETREE = " \
	adlink/${KERNEL_DEVICETREE_BASENAME}.dtb \
	adlink/23inch-overlay.dtbo \
	adlink/10inch-overlay.dtbo \
	adlink/7inch-overlay.dtbo \
	adlink/7dsi-overlay.dtbo \
	adlink/7rlcd-overlay.dtbo \
	adlink/awcm276masur-overlay.dtbo \
	adlink/awcm276mapur-overlay.dtbo \
	adlink/eth0-overlay.dtbo \
	adlink/eth1-overlay.dtbo \
	adlink/cma950mb-overlay.dtbo \
	adlink/cma750mb-overlay.dtbo \
	adlink/cma400mb-overlay.dtbo \
	adlink/snd-sgtl5000-overlay.dtbo \
	adlink/gpu128mb-overlay.dtbo \
	adlink/10auo-overlay.dtbo \
"

# compile flag for device tree overlay
EXTRA_OEMAKE:append:pn-linux-imx = " DTC_FLAGS='-@ -H epapr'"

# kernel patches
EXTRA_KERNEL_PATCHES = " \
	file://sp2-imx8mp/adlink-sp2.config \
	file://sp2-imx8mp/kernel-debug.config \
	file://sp2-imx8mp/extra-docker.config \
	file://sp2-imx8mp/0001-sp2-imx8mp-patch-sgtl5000-switch-to-highest-voltage-.patch \
	file://sp2-imx8mp/0002-sp2-imx8mp-patch-core.c-allow-dual-role-for-imx8mp-w.patch \
	file://sp2-imx8mp/0003-sp2-imx8mp-patch-realtek-phy-modify-driver-to-config.patch \
	file://sp2-imx8mp/0004-sp2-imx8mp-tpm-use-default-guard-time-from-dts-to-us.patch \
	file://sp2-imx8mp/0005-sp2-imx8mp-patch-drm-panel-enhancement-to-take-addit.patch \
	file://sp2-imx8mp/0006-sp2-imx8mp-patch-panel-simple-parse-additional-delay.patch \
	file://sp2-imx8mp/0007-sp2-imx8mp-patch-pwm-backlight-add-pre-pwm-on-delay-.patch \
	file://sp2-imx8mp/0008-sp2-imx8mp-patch-panel-lvds-introduce-delays-to-tune.patch \
	file://sp2-imx8mp/0009-sp2-imx8mp-patch-pwm-bl-and-panel-lvds-move-power-of.patch \
	file://sp2-imx8mp/0010-sp2-imx8mp-patch-mipi-dsi-ili9881c-override-mode_fla.patch \
	file://sp2-imx8mp/0011-sp2-imx8mp-patch-mipi-dsi-ili9881c-add-hannstar-p071.patch \
"
EXTRA_KERNEL_DTS = " \
    file://sp2-imx8mp/${KERNEL_DEVICETREE_BASENAME}.dts \
    file://sp2-imx8mp/23inch-overlay.dtso \
    file://sp2-imx8mp/10inch-overlay.dtso \
    file://sp2-imx8mp/7inch-overlay.dtso \
    file://sp2-imx8mp/7dsi-overlay.dtso \
    file://sp2-imx8mp/7rlcd-overlay.dtso \
    file://sp2-imx8mp/awcm276masur-overlay.dtso \
    file://sp2-imx8mp/awcm276mapur-overlay.dtso \
    file://sp2-imx8mp/eth0-overlay.dtso \
    file://sp2-imx8mp/eth1-overlay.dtso \
    file://sp2-imx8mp/cma950mb-overlay.dtso \
    file://sp2-imx8mp/cma750mb-overlay.dtso \
    file://sp2-imx8mp/cma400mb-overlay.dtso \
    file://sp2-imx8mp/snd-sgtl5000-overlay.dtso \
    file://sp2-imx8mp/gpu128mb-overlay.dtso \
    file://sp2-imx8mp/10auo-overlay.dtso \
    file://sp2-imx8mp/imx8mp.dtsi \
"

KERNEL_SRC_PATCHES[sp2-imx8mp] = " \
	${EXTRA_KERNEL_PATCHES} \
	${EXTRA_KERNEL_DTS} \
"

#
# u-boot
#
UBOOT_CONFIG_BASENAME = "adlink_sp2imx8mp"
UBOOT_CONFIG[fspi] = "${UBOOT_CONFIG_BASENAME}_defconfig"
UBOOT_DTB_NAME = "sp2imx8mp.dtb"
UBOOT_BOOT_SCRIPT = "${@bb.utils.contains('IMAGE_BASENAME', 'adlink-image-ums', 'boot.scr', 'overlay.scr', d)}"
UBOOT_SPLASH_IMAGE = "splash.bmp"
UBOOT_UMS_IMAGE = "ums.bmp"
UBOOT_EXTRA_CONFIGS ?= "LPDDR4_ALL"

# u-boot patches
EXTRA_UBOOT_PATCHES = " \
    file://sp2-imx8mp/adlink_sp2imx8mp_defconfig \
    file://sp2-imx8mp/${UBOOT_SPLASH_IMAGE} \
    file://sp2-imx8mp/${UBOOT_UMS_IMAGE} \
    file://sp2-imx8mp/0001-lib-string-Add-memmem-library-function.patch \
    file://sp2-imx8mp/0001-sp2imx8mp-patch-msgpack-add-c-6.0.0-msgpack-source.patch \
    file://sp2-imx8mp/0002-sp2imx8mp-patch-msgpack-fix-build-float-point-relate.patch \
    file://sp2-imx8mp/0003-sp2imx8mp-copy-from-imx8mp_evk-and-modify-lpddr4-tra.patch \
    file://sp2-imx8mp/0001-sp2-imx8mp-set-E_ram-env-variable-for-DTO-the-GPU_Re.patch \
"
EXTRA_UBOOT_DTS = " \
    file://sp2-imx8mp/sp2imx8mp.dts \
    file://sp2-imx8mp/sp2imx8mp-u-boot.dtsi \
"
UBOOT_SRC_PATCHES[sp2-imx8mp] = " \
	${EXTRA_UBOOT_PATCHES} \
	${EXTRA_UBOOT_DTS} \
"

#
# DDR FIRMWARE
#
DDR_FIRMWARE_VERSION = "202006"
DDR_FIRMWARE_NAME = " \
        lpddr4_pmu_train_1d_dmem_${DDR_FIRMWARE_VERSION}.bin \
        lpddr4_pmu_train_1d_imem_${DDR_FIRMWARE_VERSION}.bin \
        lpddr4_pmu_train_2d_dmem_${DDR_FIRMWARE_VERSION}.bin \
        lpddr4_pmu_train_2d_imem_${DDR_FIRMWARE_VERSION}.bin \
"

#
# imx-mkimage (boot target)
#
IMXBOOT_TARGETS_BASENAME = "flash_evk"

# Serial debug console
SERIAL_CONSOLES = "115200;ttymxc2"

#
# imx-boot
#
IMAGE_BOOTLOADER = "imx-boot"
UBOOT_MAKE_TARGET = ""

# imx-atf (no change from default 0x30890000)
#ATF_BOOT_UART_BASE = "0x30890000"

#
# Image Format (wic)
#
WIC_PARTITION_TABLE_TYPE = "msdos"
WIC_FSTAB_BLKDEV = "mmcblk2"
IMAGE_FSTYPES:append = " wic wic.md5sum"
WKS_FILE_DEPENDS:append = " imx-m7-demos"
IMAGE_BOOT_FILES += "imx8mp_m7_TCM_hello_world.bin \
                    imx8mp_m7_TCM_rpmsg_lite_pingpong_rtos_linux_remote.bin \
                    imx8mp_m7_TCM_rpmsg_lite_str_echo_rtos.bin \
                    imx8mp_m7_TCM_sai_low_power_audio.bin \
                    ${UBOOT_BOOT_SCRIPT}.uimg;boot.scr \
                    ${UBOOT_SPLASH_IMAGE};splash.bmp \
                    ${UBOOT_UMS_IMAGE};ums.bmp \
"

do_image_wic[depends] += "parted-native:do_populate_sysroot \
                          mtools-native:do_populate_sysroot \
                          dosfstools-native:do_populate_sysroot \
                          e2fsprogs-native:do_populate_sysroot \
                          u-boot-script:do_install"

ACCEPT_FSL_EULA = "1"
```

## conf/machine/sp2-imx8mpdesktop.conf
```bitbake
MACHINE="sp2-imx8mp"
require conf/machine/sp2-imx8mp.conf

include conf/machine/include/ubuntubasics.inc
```

## meta-adlink-hab/conf/layer.conf
```bitbake
# We have a conf and classes directory, add to BBPATH
BBPATH .= ":${LAYERDIR}"

# We have a packages directory, add to BBFILES
BBFILES += "${LAYERDIR}/recipes-*/*/*.bb \
            ${LAYERDIR}/recipes-*/*/*.bbappend"

BBFILE_COLLECTIONS += "adlink-hab"
BBFILE_PATTERN_adlink-hab := "^${LAYERDIR}/"
BBFILE_PRIORITY_adlink-hab = "10"

LAYERSERIES_COMPAT_adlink-hab = "kirkstone mickledore scarthgap"
```
